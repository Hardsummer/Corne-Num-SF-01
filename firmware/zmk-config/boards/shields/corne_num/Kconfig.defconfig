## firmware/zmk-config/boards/shields/corne_num/Kconfig.defconfig
```kconfig
if SHIELD_CORNE_NUM_LEFT

config ZMK_KEYBOARD_NAME
    default "Corne Num"

config ZMK_SPLIT_ROLE_CENTRAL
    default y

endif

if SHIELD_CORNE_NUM_LEFT || SHIELD_CORNE_NUM_RIGHT

config ZMK_SPLIT
    default y

endif
```

## firmware/zmk-config/boards/shields/corne_num/Kconfig.shield
```kconfig
config SHIELD_CORNE_NUM_LEFT
    def_bool $(shields_list_contains,corne_num_left)

config SHIELD_CORNE_NUM_RIGHT
    def_bool $(shields_list_contains,corne_num_right)
```

## firmware/zmk-config/boards/shields/corne_num_oled/Kconfig.shield
```kconfig
config SHIELD_CORNE_NUM_OLED
    def_bool $(shields_list_contains,corne_num_oled)
```
